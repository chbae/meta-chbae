## conf/distro/chbae.conf
```bitbake
require conf/distro/poky.conf

WEBOS_TARGET_MACHINE_VARIANT ?= "none"
WEBOS_TARGET_DISTRO_VARIANT ?= "normal"
```

## conf/layer.conf
```bitbake
# We have a conf and classes directory, add to BBPATH
BBPATH .= ":${LAYERDIR}"
# We have recipes-* directories, add to BBFILES
BBFILES += "${LAYERDIR}/recipes-*/*/*.bb"

BBFILE_COLLECTIONS += "chbae"
BBFILE_PATTERN_chbae = "^${LAYERDIR}/"
BBFILE_PRIORITY_chbae = "406"

# This should only be incremented on significant changes that will
# cause compatibility issues with other layers
LAYERVERSION_chbae = "9"

BBLAYERS_LAYERINDEX_NAME_chbae = "meta-chbae"
```
